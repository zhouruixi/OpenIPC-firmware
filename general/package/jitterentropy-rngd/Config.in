## general/package/jitterentropy-rngd/Config.in
```kconfig
config BR2_PACKAGE_JITTERENTROPY_RNGD
    bool "jitterentropy-rngd"
    depends on BR2_USE_MMU
    select BR2_PACKAGE_JITTERENTROPY_LIBRARY
    help
      Daemon to feed entropy into the Linux kernel using the Jitter RNG.
```

## general/package/legacy/digitalfpv-mavfwd/Config.in
```kconfig
config BR2_PACKAGE_DIGITALFPV_MAVFWD
	bool "digitalfpv-mavfwd"
	help
	  Simple mavlink forwarder modified by Unravel.
```

## general/package/legacy/digitalfpv-shell-drone/Config.in
```kconfig
config BR2_PACKAGE_DIGITALFPV_SHELL_DRONE
	bool "digitalfpv-shell-drone"
	help
	  digitalfpv remote shell for drone
```
